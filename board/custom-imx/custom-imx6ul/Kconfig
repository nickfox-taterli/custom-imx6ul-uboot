## board/custom-imx/custom-imx6ul/Kconfig
```kconfig
if TARGET_CUSTOM_IMX6UL

config SYS_BOARD
	default "custom-imx6ul"

config SYS_VENDOR
	default "custom-imx"

config SYS_CONFIG_NAME
	default "custom-imx6ul"

endif
```

## configs/custom_imx6ul_nand_defconfig
```kconfig
CONFIG_ARM=y
CONFIG_SYS_ARCH="arm"
CONFIG_SYS_CPU="armv7"
CONFIG_SYS_SOC="mx6"
CONFIG_HAS_VBAR=y
CONFIG_HAS_THUMB2=y
CONFIG_CPU_V7=y
CONFIG_ARCH_MX6=y
CONFIG_MX6=y
CONFIG_TARGET_CUSTOM_IMX6UL=y
CONFIG_SYS_EXTRA_OPTIONS="IMX_CONFIG=board/custom-imx/custom-imx6ul/imximage.cfg"
CONFIG_CMD_GPIO=y

#
# Network commands
#
# CONFIG_CMD_NET is not set
# CONFIG_CMD_TFTPPUT is not set
# CONFIG_CMD_TFTPSRV is not set
# CONFIG_CMD_RARP is not set
# CONFIG_CMD_DHCP is not set
# CONFIG_CMD_NFS is not set
# CONFIG_CMD_PING is not set
# CONFIG_CMD_CDP is not set
# CONFIG_CMD_SNTP is not set
# CONFIG_CMD_DNS is not set
# CONFIG_CMD_LINK_LOCAL is not set

# CONFIG_LDO_BYPASS_CHECK is not set
```
